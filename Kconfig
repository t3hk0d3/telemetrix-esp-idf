## Kconfig
```kconfig
menu "Telemetrix"

    config TELEMETRIX_DHT
        bool "DHT22 support"
        default y

    config TELEMETRIX_SONAR
        bool "HC-SR04 sonar support"
        default y

    config TELEMETRIX_ONE_WIRE
        bool "1-wire support"
        default y

    config TELEMETRIX_SERVO
        bool "Servo support"
        default y

    config TELEMETRIX_I2C
        bool "I2C support"
        default y

    config TELEMETRIX_ANALOG
        bool "Analog input support"
        default y

endmenu
```

## examples/devkit_wifi/main/Kconfig.projbuild
```kconfig
menu "Telemetrix example"

    config EXAMPLE_WIFI_SSID
        string "Wi-Fi SSID"
        default "myssid"

    config EXAMPLE_WIFI_PASSWORD
        string "Wi-Fi password"
        default "mypassword"
        help
            An empty password connects to an open network.

endmenu
```

## examples/esp32_poe/main/Kconfig.projbuild
```kconfig
menu "Telemetrix example"

    choice EXAMPLE_NETWORK
        prompt "Network"
        default EXAMPLE_NETWORK_ETHERNET
        help
            The board's LAN8720 Ethernet port or Wi-Fi station. The pin profile is the same for both.

        config EXAMPLE_NETWORK_ETHERNET
            bool "Ethernet (LAN8720)"
        config EXAMPLE_NETWORK_WIFI
            bool "Wi-Fi station"
    endchoice

    config EXAMPLE_WIFI_SSID
        string "Wi-Fi SSID"
        depends on EXAMPLE_NETWORK_WIFI
        default "myssid"

    config EXAMPLE_WIFI_PASSWORD
        string "Wi-Fi password"
        depends on EXAMPLE_NETWORK_WIFI
        default "mypassword"
        help
            An empty password connects to an open network.

endmenu
```

## examples/esp32_poe/sdkconfig.defaults.wifi
```kconfig
# Layered over sdkconfig.defaults: SDKCONFIG_DEFAULTS="sdkconfig.defaults;sdkconfig.defaults.wifi"
CONFIG_EXAMPLE_NETWORK_WIFI=y
```
